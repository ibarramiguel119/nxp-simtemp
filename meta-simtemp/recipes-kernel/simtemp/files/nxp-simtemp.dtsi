// SPDX-License-Identifier: GPL-2.0
// NXP Simulated Temperature Sensor Device Tree Include

&{/} {
    simtemp0: simtemp@0 {
        compatible = "nxp,simtemp";
        sampling-ms = <100>;
        threshold-mC = <45000>;
        status = "okay";
    };
};
