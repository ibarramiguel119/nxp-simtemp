## meta-simtemp/conf/layer.conf
```bitbake
# meta-simtemp/conf/layer.conf
BBPATH .= ":${LAYERDIR}"


# e incluimos los archivos .bbappend dentro de las comillas.
BBFILES += "${LAYERDIR}/recipes-*/*/*.bb \
            ${LAYERDIR}/recipes-*/*/*.bbappend"

BBFILE_COLLECTIONS += "simtemp"
BBFILE_PATTERN_simtemp = "^${LAYERDIR}/"
BBFILE_PRIORITY_simtemp = "9"
LAYERSERIES_COMPAT_simtemp = "walnascar scarthgap kirkstone"
```
